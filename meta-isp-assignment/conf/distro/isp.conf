## meta-isp-assignment/conf/layer.conf
```bitbake
# Layer configuration for meta-isp-assignment

BBPATH .= ":${LAYERDIR}"

BBFILES += "${LAYERDIR}/recipes-*/*/*.bb \
            ${LAYERDIR}/recipes-*/*/*.bbappend"

BBFILE_COLLECTIONS += "isp-assignment"
BBFILE_PATTERN_isp-assignment = "^${LAYERDIR}/"
BBFILE_PRIORITY_isp-assignment = "10"

LAYERDEPENDS_isp-assignment = "core openembedded-layer multimedia-layer"
LAYERSERIES_COMPAT_isp-assignment = "scarthgap"
```
